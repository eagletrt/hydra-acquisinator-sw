VERSION ""

NS_ :

BS_:

BU_: Acquisinator

BO_ 18 ACQUISINATOR_RAW: 8 Acquisinator
 SG_ Debug_adcRaw_U : 0|16@1+ (1,0) [0|65535] ""  Vector__XXX

CM_ BU_ Acquisinator "Strain gauge acquisition board.";
CM_ BO_ 18 "One frame per raw ADC sample (amplifier output, CH0).";
CM_ SG_ 18 Debug_adcRaw_U "Raw ADC code (0..65535), not converted to volts.";
BA_DEF_ SG_  "SignalTypeName" STRING ;
BA_DEF_ SG_  "SignalType" STRING ;
BA_DEF_DEF_  "SignalTypeName" "";
BA_DEF_DEF_  "SignalType" "";
BA_ "SignalTypeName" SG_ 18 Debug_adcRaw_U "uint16";
BA_ "SignalType" SG_ 18 Debug_adcRaw_U "uint";
